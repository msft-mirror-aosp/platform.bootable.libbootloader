/dts-v1/;

/ {
    info = "test device tree from dtb partition";

    chosen {
        bootargs = "existing_arg_1=existing_val_1 existing_arg_2=existing_val_2";
        dtb_slot = "b";
        fixup = <0x0>;
    };
};
