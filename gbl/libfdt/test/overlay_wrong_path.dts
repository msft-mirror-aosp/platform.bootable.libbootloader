/dts-v1/;
/plugin/;

// re-generate and push test artifacts using ./gen_test_dtb.sh after change in this file
/ {
    // check wrong target-path
    fragment@0 {
        target-path = "/doesnt-exist";
        __overlay__ {
            property-1 = "overlay1-property-1-value";
        };
    };
};